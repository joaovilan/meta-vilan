## conf/layer.conf
```bitbake
# We have a conf and classes directory, append to BBPATH
BBPATH .= ":${LAYERDIR}"

# We have a recipes directory, add to BBFILES
BBFILES += "${LAYERDIR}/recipes*/*/*.bb ${LAYERDIR}/recipes*/*/*.bbappend"

BBFILE_COLLECTIONS += "meta-vilan"
BBFILE_PATTERN_meta-vilan := "^${LAYERDIR}/"
BBFILE_PRIORITY_meta-vilan = "7"
```

## recipes-kernel/linux/files/Kconfig.patch
```kconfig
--- a/drivers/video/logo/Kconfig	2019-06-07 15:55:32.083279293 -0300
+++ b/drivers/video/logo/Kconfig	2019-06-07 15:56:08.507704012 -0300
@@ -84,6 +84,7 @@
 
 config LOGO_CUSTOM_CLUT224
 	bool "Custom 224-color Linux logo"
-	default n
+	depends on LOGO
+	default y
 
 endif # LOGO
```
